/ {
    chosen {
        zmk,kscan = &kscan0;
    };

    kscan0: kscan {
        compatible = "zmk,kscan-gpio-direct";
        input-gpios =
            <&gpio0 17 (GPIO_ACTIVE_LOW | GPIO_PULL_UP)>,
            <&gpio0 20 (GPIO_ACTIVE_LOW | GPIO_PULL_UP)>,
            <&gpio0 22 (GPIO_ACTIVE_LOW | GPIO_PULL_UP)>;
    };
};